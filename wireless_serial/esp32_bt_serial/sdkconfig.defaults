## wireless_serial/esp32_target/sdkconfig.defaults
```kconfig
# WiLoc Target — SoftAP beacon broadcaster + BLE debug

# Bluetooth — NimBLE
CONFIG_BT_ENABLED=y
CONFIG_BT_NIMBLE_ENABLED=y
CONFIG_BT_NIMBLE_MAX_CONNECTIONS=1
CONFIG_BT_NIMBLE_ATT_PREFERRED_MTU=256

# WiFi
CONFIG_ESP_WIFI_SOFTAP_SUPPORT=y

# Coexistence
CONFIG_ESP_COEX_SW_COEXIST_ENABLE=y

# Performance
CONFIG_FREERTOS_HZ=1000

# Partition table
CONFIG_PARTITION_TABLE_CUSTOM=y
CONFIG_PARTITION_TABLE_CUSTOM_FILENAME="partitions.csv"

# Logging
CONFIG_LOG_DEFAULT_LEVEL_INFO=y
```
